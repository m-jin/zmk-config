## config/west.yml
```yaml
manifest:
  remotes:
    - name: zmkfirmware
      url-base: https://github.com/zmkfirmware
    - name: mjin
      url-base: https://github.com/m-jin
  projects:
    - name: zmk
      remote: mjin
      revision: main
      import: app/west.yml
  self:
    path: config
```
